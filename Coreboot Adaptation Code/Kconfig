## Coreboot Adaptation Code/Kconfig
```kconfig
# SPDX-License-Identifier: GPL-2.0-only

if BOARD_LENOVO_SKL_IDEAPAD_320_14ISK

config BOARD_SPECIFIC_OPTIONS
    def_bool y
	#select AZALIA_USE_LEGACY_VERB_TABLE
	select BOARD_ROMSIZE_KB_8192
	#select HAVE_ACPI_RESUME
	select HAVE_ACPI_TABLES
	select INTEL_GMA_HAVE_VBT
	select MAINBOARD_HAS_LIBGFXINIT
	select SOC_INTEL_COMMON_BLOCK_HDA_VERB
	select SOC_INTEL_SKYLAKE
	select SYSTEM_TYPE_LAPTOP
    select SUPERIO_ITE_IT8528E
    select ITE_ENV_CTRL
    select HAVE_IFD_BIN
    select HAVE_ME_BIN

config MAINBOARD_DIR
	default "lenovo/skl_ideapad320-14isk"

config MAINBOARD_PART_NUMBER
	default "320-14isk"

config CBFS_SIZE
	default 0x5f0000

config MAX_CPUS
	default 8

config DIMM_MAX
	default 2

config DIMM_SPD_SIZE
	default 512	# DDR4

config CONSOLE_SERIAL
	default y

config NO_POST
	default n

endif
```

## Coreboot Adaptation Code/Kconfig.name
```kconfig
# SPDX-License-Identifier: GPL-2.0-only

config BOARD_LENOVO_SKL_IDEAPAD_320_14ISK
	bool "Ideapad 320-14ISK"
```
